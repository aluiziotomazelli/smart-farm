## app_ota_sender/Kconfig.projbuild
```kconfig
menu "OTA Sender Configuration"

    config OTA_SENDER_FIRMWARE_URL
        string "Firmware URL"
        default "http://192.168.1.100:8070/firmware.bin"
        help
            URL of the firmware binary for the OTA update.

    config OTA_SENDER_WIFI_SSID
        string "WiFi SSID"
        default "YOUR_WIFI_SSID"
        help
            SSID of the WiFi network to connect to for the OTA update.

    config OTA_SENDER_WIFI_PASSWORD
        string "WiFi Password"
        default "YOUR_WIFI_PASSWORD"
        help
            Password of the WiFi network.

endmenu
```

## app_test/main/Kconfig.projbuild
```kconfig
menu "OTA Sender Configuration"

    config OTA_SENDER_FIRMWARE_URL
        string "Firmware URL"
        default "http://192.168.1.100:8070/firmware.bin"
        help
            URL of the firmware binary for the OTA update.

    config OTA_SENDER_WIFI_SSID
        string "WiFi SSID"
        default ""
        help
            SSID of the WiFi network to connect to for the OTA update. Leave blank to use stored credentials on the target device.

    config OTA_SENDER_WIFI_PASSWORD
        string "WiFi Password"
        default ""
        help
            Password of the WiFi network.

endmenu
```

## components/gpio_validator/test/sdkconfig.defaults.linux
```kconfig
# Linux target configurations
# The 'driver' component is not available on Linux, so we may need to mock it
# or adjust dependencies if the component under test uses it heavily.
CONFIG_IDF_TARGET_LINUX=y
```

## components/power_control/test/sdkconfig.defaults
```kconfig
# Common configurations for testing
CONFIG_UNITY_ENABLE_BACKTRACE_ON_FAIL=y
CONFIG_UNITY_ENABLE_FIXTURE=n
CONFIG_UNITY_ENABLE_IDF_TEST_RUNNER=y

# Increase stack size for tests if needed
CONFIG_ESP_MAIN_TASK_STACK_SIZE=4096

# Log level
CONFIG_LOG_DEFAULT_LEVEL_INFO=y
CONFIG_ESP_TASK_WDT_INIT=n
```
